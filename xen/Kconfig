## xen/Kconfig
```kconfig
#
# For a description of the syntax of this configuration file,
# see Documentation/kbuild/kconfig-language.txt from the Linux
# kernel source tree.
#
mainmenu "Xen/$SRCARCH $XEN_FULLVERSION Configuration"

config SRCARCH
	string
	option env="SRCARCH"

config ARCH
	string
	option env="ARCH"

source "arch/$SRCARCH/Kconfig"

config XEN_FULLVERSION
	string
	option env="XEN_FULLVERSION"

config DEFCONFIG_LIST
	string
	option defconfig_list
	default "$ARCH_DEFCONFIG"
	default "arch/$SRCARCH/defconfig"
```

## xen/arch/arm/Kconfig
```kconfig
# Select 32 or 64 bit
config 64BIT
	bool "64-bit Xen" if ARCH = "arm64"
	default ARCH != "arm32"
	help
	  Say yes to build a 64-bit Xen
	  Say no to build a 32-bit Xen

config ARM_32
       def_bool y
       depends on !64BIT

config ARM_64
       def_bool y
       depends on 64BIT

config ARM
	def_bool y
	select HAS_PASSTHROUGH

config ARCH_DEFCONFIG
	string
	default "arch/arm/arm32_defconfig" if ARM_32
	default "arch/arm/arm64_defconfig" if ARM_64

menu "Architecture Features"

endmenu

source "common/Kconfig"

source "drivers/Kconfig"
```

## xen/arch/arm/configs/arm32_defconfig
```kconfig
CONFIG_64BIT=n
CONFIG_UART_NS16550=y
CONFIG_UART_PL011=y
CONFIG_UART_EXYNOS4210=y
CONFIG_UART_OMAP=y
```

## xen/arch/x86/Kconfig
```kconfig
config X86_64
	def_bool y

config X86
	def_bool y
	select HAS_ACPI
	select HAS_CPUFREQ
	select HAS_EHCI
	select HAS_GDBSX
	select HAS_IOPORTS
	select HAS_KEXEC
	select HAS_MEM_ACCESS
	select HAS_MEM_PAGING
	select HAS_MEM_SHARING
	select HAS_NS16550
	select HAS_PASSTHROUGH
	select HAS_PCI
	select HAS_PDX
	select HAS_VGA

config ARCH_DEFCONFIG
	string
	default "arch/x86/configs/x86_64_defconfig"

menu "Architecture Features"

config COMPAT
	def_bool y
	help
	  32-bit interface support on 64-bit Xen which is used for both
	  HVM and PV guests. HVMLoader makes 32-bit hypercalls irrespective
	  of the destination runmode of the guest.

endmenu

source "common/Kconfig"

source "drivers/Kconfig"
```

## xen/common/Kconfig
```kconfig
menu "Common Features"

# Select HAS_DEVICE_TREE if device tree is supported
config HAS_DEVICE_TREE
	bool

# Select HAS_PDX if PDX is supported
config HAS_PDX
	bool

# Select HAS_KEXEC if kexec is supported
config HAS_KEXEC
	bool

# Select HAS_GDBSX if GDBSX is supported
config HAS_GDBSX
	bool

endmenu
```

## xen/drivers/char/Kconfig
```kconfig
config UART_NS16550
	bool "16550-series UART support"
	help
	  This selects the 16550-series UART support. For most systems, say Y.

# Select HAS_IOPORTS if 16550 has I/O ports
config HAS_IOPORTS
	bool
	depends on UART_NS16550

config UART_CADENCE
	bool "Xilinx Zynq Cadence UART support"
	depends on ARM_64
	help
	  This selects the Xilinx Zynq Cadence UART. If you have a Xilinx Zynq
	  based board, say Y.

config UART_PL011
	bool "ARM AMBA PL011 UART support"
	depends on ARM
	help
	  This selects the ARM(R) AMBA(R) PrimeCell PL011 UART. If you have
	  an Integrator/PP2, Integrator/CP or Versatile platform, say Y.

config UART_EXYNOS4210
	bool "Samsung Exynos 4210 UART support"
	depends on ARM_32
	help
	  This selects the Samsung Exynos 4210 UART. If you have a Samsung
	  Exynos based board, say Y.

config UART_OMAP
	bool "OMAP UART support"
	depends on ARM_32
	help
	  This selects the Texas Instruments OMAP UART. If you have a Texas
	  Instruments based CPU, say Y.

config UART_SCIF
	bool "SuperH SCI(F) UART support"
	depends on ARM_32
	help
	  This selects the SuperH SCI(F) UART. If you have a SuperH based board,
	  say Y.
```

## xen/drivers/passthrough/Kconfig
```kconfig
# Select HAS_PASSTHROUGH if PCI pass through is supported
config HAS_PASSTHROUGH
	bool
```

## xen/drivers/video/Kconfig
```kconfig
# Select HAS_VIDEO if video is supported
config HAS_VIDEO
	bool

# Select HAS_VGA if VGA is supported
config HAS_VGA
       bool

# Select HAS_ARM_HDLCD if ARM HDLCD is supported
config HAS_ARM_HDLCD
	bool
```
